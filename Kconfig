## Kconfig
```kconfig
menuconfig ZMK_PSP_JOYSTICK
    bool "Enable psp-joystick feature"
    help
      Enable PSP thumbstick state, Studio RPC, and the ADC driver.

if ZMK_PSP_JOYSTICK

config ZMK_PSP_JOYSTICK_DRIVER
    bool "PSP joystick ADC input driver"
    default y if DT_HAS_TOKYO2006_PSP_JOYSTICK_ENABLED
    depends on INPUT && ADC

config ZMK_PSP_JOYSTICK_DEDICATED_WORKQUEUE
    bool "Use a dedicated workqueue for joystick sampling"
    default y
    depends on ZMK_PSP_JOYSTICK_DRIVER
    help
      Run the joystick sampling work on its own workqueue instead of the
      shared system workqueue. On a keyboard the TPS43 trackpad, RGB and
      other drivers also use the system workqueue; a slow I2C transfer can
      delay joystick samples and make the pointer stutter.

config ZMK_PSP_JOYSTICK_WORKQUEUE_STACK_SIZE
    int "Dedicated workqueue stack size"
    default 2048
    depends on ZMK_PSP_JOYSTICK_DEDICATED_WORKQUEUE

config ZMK_PSP_JOYSTICK_WORKQUEUE_PRIORITY
    int "Dedicated workqueue priority"
    default 0
    depends on ZMK_PSP_JOYSTICK_DEDICATED_WORKQUEUE

config ZMK_PSP_JOYSTICK_STUDIO_RPC
    bool "Enable psp-joystick custom Studio RPC"
    depends on ZMK_STUDIO

config ZMK_PSP_JOYSTICK_SPLIT_RELAY
    bool "Relay psp-joystick state to split peripherals"
    depends on ZMK_SPLIT && ZMK_SPLIT_RELAY_EVENT && ZMK_SPLIT_BLE
    help
      Requires the BLE split transport. At the pinned ZMK revision,
      relay events are not implemented for the wired split transport,
      so this option is unavailable on a wired-only central.

module = ZMK_PSP_JOYSTICK
module-str = ZMK_PSP_JOYSTICK
source "${ZEPHYR_BASE}/subsys/logging/Kconfig.template.log_config"

endif
```

## dts/bindings/input/tokyo2006,psp-joystick.yaml
```yaml
description: |
  PSP analog thumbstick built from two ratiometric potentiometers. The
  driver samples X and Y ADC channels, calibrates the center, and emits
  relative pointer events.

compatible: "tokyo2006,psp-joystick"

include: [base.yaml]

properties:
  io-channels:
    type: phandle-array
    required: true
    description: X and Y ADC channels, in that order.
  io-channel-names:
    type: string-array
    required: true
    description: Must be "x" and "y".
  sample-interval-ms:
    type: int
    default: 8
    description: Sampling period in milliseconds (4-50).
  deadzone-percent:
    type: int
    default: 8
    description: Deadzone as a percentage of full deflection (0-50).
  max-speed:
    type: int
    default: 8
    description: REL units per sample at full deflection (1-64).
  curve-exponent-x100:
    type: int
    default: 100
    enum: [100, 150, 200, 250, 300]
    description: Response-curve exponent times 100.
  smoothing-percent:
    type: int
    default: 0
    description: One-pole EMA weight of the new sample (0-90).
  invert-x:
    type: boolean
    description: Invert the X axis.
  invert-y:
    type: boolean
    description: Invert the Y axis.
  swap-xy:
    type: boolean
    description: Swap the X and Y axes.
  arrow-mode:
    type: int
    default: 0
    enum: [0, 1]
    description: |
      When 1, emit INPUT_KEY_UP/DOWN/LEFT/RIGHT input events instead of
      relative pointer movement. Map them to key bindings with a
      zmk,input-processor-behaviors node on the input listener.
  arrow-threshold-percent:
    type: int
    default: 50
    description: Deflection needed to press an arrow key (1-95% of full scale).
  auto-center:
    type: int
    default: 1
    enum: [0, 1]
    description: |
      1 enables boot-time auto-centering unless a persisted center exists;
      0 disables it and uses center-x/center-y (or the default center).
  auto-center-ms:
    type: int
    default: 500
    description: Calibration window in milliseconds (100-2000).
  auto-recenter:
    type: int
    default: 1
    enum: [0, 1]
    description: |
      1 updates the center while the stick stays still near the current
      center, tracking rest drift / mechanical hysteresis. Not persisted.
  auto-recenter-ms:
    type: int
    default: 1000
    description: How long the stick must stay still before the center updates.
  center-x:
    type: int
    description: Expected raw X center and fallback when calibration fails.
  center-y:
    type: int
    description: Expected raw Y center and fallback when calibration fails.
  min-x:
    type: int
    default: 0
    description: Raw X value at full negative deflection.
  max-x:
    type: int
    default: 4095
    description: Raw X value at full positive deflection.
  min-y:
    type: int
    default: 0
    description: Raw Y value at full negative deflection.
  max-y:
    type: int
    default: 4095
    description: Raw Y value at full positive deflection.
```
